## firmware/main/Kconfig.projbuild
```kconfig
menu "Zelenka"

    config ZELENKA_API_URL
        string "Default API URL"
        default "https://zelenka-api.ru/api/device/measurements"
        help
            Server endpoint that accepts measurement batches. NVS overrides
            this if the captive portal saved a custom URL — otherwise this
            compile-time default wins.

    config ZELENKA_SAMPLE_INTERVAL_SEC
        int "Seconds between samples"
        default 600
        range 5 3600
        help
            Production target: 600 (10 min). Drop to 30 for development.

    config ZELENKA_BATCH_SIZE
        int "Samples per batch POST"
        default 6
        range 1 64
        help
            At 10-min sampling with batch=6, the radio comes up once per hour.

endmenu
```
